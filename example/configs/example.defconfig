## example/configs/example.defconfig
```kconfig
CONFIG_LV_USE_CLIB_MALLOC=y
CONFIG_LV_USE_CLIB_STRING=y
CONFIG_LV_USE_CLIB_SPRINTF=y
CONFIG_LV_OS_PTHREAD=y
CONFIG_LV_COLOR_DEPTH_32=y
CONFIG_LV_DEF_REFR_PERIOD=16
CONFIG_LV_USE_MATRIX=y
CONFIG_LV_DRAW_LAYER_SIMPLE_BUF_SIZE=262144
CONFIG_LV_DRAW_THREAD_STACK_SIZE=65536
CONFIG_LV_DRAW_SW_DRAW_UNIT_CNT=2
CONFIG_LV_DRAW_SW_SHADOW_CACHE_SIZE=1024
CONFIG_LV_USE_TRANSLATION=y
CONFIG_LV_CACHE_DEF_SIZE=4096
CONFIG_LV_IMAGE_HEADER_CACHE_DEF_CNT=4096
CONFIG_LV_USE_BIDI=y
CONFIG_LV_USE_ARABIC_PERSIAN_CHARS=y
CONFIG_LV_FONT_MONTSERRAT_16=y
CONFIG_LV_FONT_MONTSERRAT_20=y
CONFIG_LV_FONT_MONTSERRAT_28=y
CONFIG_LV_FONT_DEJAVU_16_PERSIAN_HEBREW=y
CONFIG_LV_FONT_UNSCII_8=y
CONFIG_LV_FONT_UNSCII_16=y
CONFIG_LV_USE_SDL=y
CONFIG_LV_SDL_BUF_COUNT=2
# CONFIG_LV_BUILD_EXAMPLES is not set
# CONFIG_LV_BUILD_DEMOS is not set
```
